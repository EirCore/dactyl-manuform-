## config/boards/shields/charybdis_cirque/Kconfig.defconfig
```kconfig
if SHIELD_CHARYBDIS_CIRQUE_RIGHT

    config ZMK_KEYBOARD_NAME
        default "ding-5x7"

    config ZMK_SPLIT_ROLE_CENTRAL
        default y

endif

if SHIELD_CHARYBDIS_CIRQUE_LEFT

    config ZMK_KEYBOARD_NAME
        default "ding-5x7-slave"

endif

if SHIELD_CHARYBDIS_CIRQUE_LEFT || SHIELD_CHARYBDIS_CIRQUE_RIGHT

    config ZMK_SPLIT
        default y
    config ZMK_USB
        default y
    config ZMK_BOARD_COMPAT
        bool
        default y

endif
```
